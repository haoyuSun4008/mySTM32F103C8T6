/******************************************************************************
* ASAP2 file: RBM.a2l
* Code generation for model "RBM".
* Model version : 1.1842
* Simulink Coder version : 9.0 (R2018b) 24-May-2018
* C source code generated on : Thu Aug 27 10:51:32 2020
* Target selection: ert.tlc
* Embedded hardware selection: STMicroelectronics->STM32 32-bit Cortex-M
* Code generation objectives:
* 1. Execution efficiency
* 2. ROM efficiency
* 3. RAM efficiency
* 4. Traceability
* 5. Safety precaution
* 6. Debugging
* 7. MISRA C:2012 guidelines
* 8. Polyspace
* Validation result: Not run
* (add additional file header information here)
******************************************************************************/ ASAP2_VERSION 1 31
/* Version 1.31 */
/begin PROJECT ProjectName "Project Comment Goes Here"
/begin HEADER "Header Comments go here" /end HEADER
/begin MODULE ModuleName "Module Comment Goes Here"
/begin MOD_PAR "MOD PAR Comment Goes Here" /end MOD_PAR
/begin MOD_COMMON "Mod Common Comment Here" BYTE_ORDER MSB_LAST /end MOD_COMMON
/begin RECORD_LAYOUT Scalar_BOOLEAN FNC_VALUES 1 UBYTE COLUMN_DIR DIRECT /end RECORD_LAYOUT
/begin RECORD_LAYOUT Scalar_UBYTE FNC_VALUES 1 UBYTE COLUMN_DIR DIRECT /end RECORD_LAYOUT
/begin RECORD_LAYOUT Scalar_BYTE FNC_VALUES 1 SBYTE COLUMN_DIR DIRECT /end RECORD_LAYOUT
/begin RECORD_LAYOUT Scalar_UWORD FNC_VALUES 1 UWORD COLUMN_DIR DIRECT /end RECORD_LAYOUT
/begin RECORD_LAYOUT Scalar_SWORD FNC_VALUES 1 SWORD COLUMN_DIR DIRECT /end RECORD_LAYOUT
/begin RECORD_LAYOUT Scalar_ULONG FNC_VALUES 1 ULONG COLUMN_DIR DIRECT /end RECORD_LAYOUT
/begin RECORD_LAYOUT Scalar_LONG FNC_VALUES 1 SLONG COLUMN_DIR DIRECT /end RECORD_LAYOUT
/begin RECORD_LAYOUT Scalar_FLOAT32_IEEE FNC_VALUES 1 FLOAT32_IEEE COLUMN_DIR DIRECT /end RECORD_LAYOUT
/begin RECORD_LAYOUT Scalar_FLOAT64_IEEE FNC_VALUES 1 FLOAT64_IEEE COLUMN_DIR DIRECT /end RECORD_LAYOUT
/begin RECORD_LAYOUT Lookup1D_BOOLEAN FNC_VALUES 1 UBYTE COLUMN_DIR DIRECT /end RECORD_LAYOUT
/begin RECORD_LAYOUT Lookup1D_X_BOOLEAN AXIS_PTS_X 1 UBYTE INDEX_INCR DIRECT /end RECORD_LAYOUT
/begin RECORD_LAYOUT Lookup1D_BYTE FNC_VALUES 1 SBYTE COLUMN_DIR DIRECT /end RECORD_LAYOUT
/begin RECORD_LAYOUT Lookup1D_X_BYTE AXIS_PTS_X 1 SBYTE INDEX_INCR DIRECT /end RECORD_LAYOUT
/begin RECORD_LAYOUT Lookup1D_UBYTE FNC_VALUES 1 UBYTE COLUMN_DIR DIRECT /end RECORD_LAYOUT
/begin RECORD_LAYOUT Lookup1D_X_UBYTE AXIS_PTS_X 1 UBYTE INDEX_INCR DIRECT /end RECORD_LAYOUT
/begin RECORD_LAYOUT Lookup1D_UWORD FNC_VALUES 1 UWORD COLUMN_DIR DIRECT /end RECORD_LAYOUT
/begin RECORD_LAYOUT Lookup1D_X_UWORD AXIS_PTS_X 1 UWORD INDEX_INCR DIRECT /end RECORD_LAYOUT
/begin RECORD_LAYOUT Lookup1D_WORD FNC_VALUES 1 SWORD COLUMN_DIR DIRECT /end RECORD_LAYOUT
/begin RECORD_LAYOUT Lookup1D_X_WORD AXIS_PTS_X 1 SWORD INDEX_INCR DIRECT /end RECORD_LAYOUT
/begin RECORD_LAYOUT Lookup1D_ULONG FNC_VALUES 1 ULONG COLUMN_DIR DIRECT /end RECORD_LAYOUT
/begin RECORD_LAYOUT Lookup1D_X_ULONG AXIS_PTS_X 1 ULONG INDEX_INCR DIRECT /end RECORD_LAYOUT
/begin RECORD_LAYOUT Lookup1D_SLONG FNC_VALUES 1 SLONG COLUMN_DIR DIRECT /end RECORD_LAYOUT
/begin RECORD_LAYOUT Lookup1D_X_LONG AXIS_PTS_X 1 SLONG INDEX_INCR DIRECT /end RECORD_LAYOUT
/begin RECORD_LAYOUT Lookup1D_FLOAT32_IEEE FNC_VALUES 1 FLOAT32_IEEE COLUMN_DIR DIRECT /end RECORD_LAYOUT
/begin RECORD_LAYOUT Lookup1D_X_FLOAT32_IEEE AXIS_PTS_X 1 FLOAT32_IEEE INDEX_INCR DIRECT /end RECORD_LAYOUT
/begin RECORD_LAYOUT Lookup1D_FLOAT64_IEEE FNC_VALUES 1 FLOAT64_IEEE COLUMN_DIR DIRECT /end RECORD_LAYOUT
/begin RECORD_LAYOUT Lookup1D_X_FLOAT64_IEEE AXIS_PTS_X 1 FLOAT64_IEEE INDEX_INCR DIRECT /end RECORD_LAYOUT
/begin RECORD_LAYOUT Lookup2D_BOOLEAN FNC_VALUES 1 UBYTE COLUMN_DIR DIRECT /end RECORD_LAYOUT
/begin RECORD_LAYOUT Lookup2D_X_BOOLEAN AXIS_PTS_X 1 UBYTE INDEX_INCR DIRECT /end RECORD_LAYOUT
/begin RECORD_LAYOUT Lookup2D_UBYTE FNC_VALUES 1 UBYTE COLUMN_DIR DIRECT /end RECORD_LAYOUT
/begin RECORD_LAYOUT Lookup2D_X_UBYTE AXIS_PTS_X 1 UBYTE INDEX_INCR DIRECT /end RECORD_LAYOUT
/begin RECORD_LAYOUT Lookup2D_BYTE FNC_VALUES 1 SBYTE COLUMN_DIR DIRECT /end RECORD_LAYOUT
/begin RECORD_LAYOUT Lookup2D_X_BYTE AXIS_PTS_X 1 SBYTE INDEX_INCR DIRECT /end RECORD_LAYOUT
/begin RECORD_LAYOUT Lookup2D_UWORD FNC_VALUES 1 UWORD COLUMN_DIR DIRECT /end RECORD_LAYOUT
/begin RECORD_LAYOUT Lookup2D_X_UWORD AXIS_PTS_X 1 UWORD INDEX_INCR DIRECT /end RECORD_LAYOUT
/begin RECORD_LAYOUT Lookup2D_WORD FNC_VALUES 1 SWORD COLUMN_DIR DIRECT /end RECORD_LAYOUT
/begin RECORD_LAYOUT Lookup2D_X_WORD AXIS_PTS_X 1 SWORD INDEX_INCR DIRECT /end RECORD_LAYOUT
/begin RECORD_LAYOUT Lookup2D_ULONG FNC_VALUES 1 ULONG COLUMN_DIR DIRECT /end RECORD_LAYOUT
/begin RECORD_LAYOUT Lookup2D_X_ULONG AXIS_PTS_X 1 ULONG INDEX_INCR DIRECT /end RECORD_LAYOUT
/begin RECORD_LAYOUT Lookup2D_LONG FNC_VALUES 1 SLONG COLUMN_DIR DIRECT /end RECORD_LAYOUT
/begin RECORD_LAYOUT Lookup2D_X_LONG AXIS_PTS_X 1 SLONG INDEX_INCR DIRECT /end RECORD_LAYOUT
/begin RECORD_LAYOUT Lookup2D_FLOAT32_IEEE FNC_VALUES 1 FLOAT32_IEEE COLUMN_DIR DIRECT /end RECORD_LAYOUT
/begin RECORD_LAYOUT Lookup2D_X_FLOAT32_IEEE AXIS_PTS_X 1 FLOAT32_IEEE INDEX_INCR DIRECT /end RECORD_LAYOUT
/begin RECORD_LAYOUT Lookup2D_FLOAT64_IEEE FNC_VALUES 1 FLOAT64_IEEE COLUMN_DIR DIRECT /end RECORD_LAYOUT
/begin RECORD_LAYOUT Lookup2D_X_FLOAT64_IEEE AXIS_PTS_X 1 FLOAT64_IEEE INDEX_INCR DIRECT /end RECORD_LAYOUT
/begin CHARACTERISTIC K_RB_MapP2PDecouple_OutP_s16En7Bar "" CURVE 0x0000 /* @ECU_Address@K_RB_MapP2PDecouple_OutP_s16En7Bar@ */ Lookup1D_WORD 0 RBM_CM_sfix16_En7 -256.0 255.9921875
 /begin AXIS_DESCR COM_AXIS V_InRBM_PTar_s16s7_Bar RBM_CM_sfix16_En7 13 -256.0 255.9921875 AXIS_PTS_REF K_RB_MapP2PDecouple_InP_s16En7Bar /end AXIS_DESCR
/end CHARACTERISTIC
/begin AXIS_PTS K_RB_MapP2PDecouple_InP_s16En7Bar "" 0x0000 /* @ECU_Address@K_RB_MapP2PDecouple_InP_s16En7Bar@ */ V_InRBM_PTar_s16s7_Bar Lookup1D_X_WORD 0 RBM_CM_sfix16_En7 13 -256.0 255.9921875 /end AXIS_PTS
/begin CHARACTERISTIC K_RB_MapS2PDecouple_OutP_s16En7Bar "" CURVE 0x0000 /* @ECU_Address@K_RB_MapS2PDecouple_OutP_s16En7Bar@ */ Lookup1D_WORD 0 RBM_CM_sfix16_En7 -256.0 255.9921875
 /begin AXIS_DESCR COM_AXIS V_InRBM_BrkPdlStk_s16s5_mm RBM_CM_sfix16_En7 9 -256.0 255.9921875 AXIS_PTS_REF K_RB_MapS2PDecouple_InS_s16En5mm /end AXIS_DESCR
/end CHARACTERISTIC
/begin AXIS_PTS K_RB_MapS2PDecouple_InS_s16En5mm "" 0x0000 /* @ECU_Address@K_RB_MapS2PDecouple_InS_s16En5mm@ */ V_InRBM_BrkPdlStk_s16s5_mm Lookup1D_X_WORD 0 RBM_CM_sfix16_En7 9 -256.0 255.9921875 /end AXIS_PTS
/begin CHARACTERISTIC K_RB_EPSLimitTorqueMap_Tq_0P1Nm "" CURVE 0x0000 /* @ECU_Address@K_RB_EPSLimitTorqueMap_Tq_0P1Nm@ */ Lookup1D_WORD 0 RBM_CM_int16 -32768 32767
 /begin AXIS_DESCR COM_AXIS NO_INPUT_QUANTITY RBM_CM_int16 4 -32768 32767 AXIS_PTS_REF K_RB_EPSLimitTorqueMap_Angle_Deg /end AXIS_DESCR
/end CHARACTERISTIC
/begin AXIS_PTS K_RB_EPSLimitTorqueMap_Angle_Deg "" 0x0000 /* @ECU_Address@K_RB_EPSLimitTorqueMap_Angle_Deg@ */ NO_INPUT_QUANTITY Lookup1D_X_WORD 0 RBM_CM_int16 4 -32768 32767 /end AXIS_PTS
/begin CHARACTERISTIC K_RB_MapMotorCharacter_OutTq_Rpm "" CURVE 0x0000 /* @ECU_Address@K_RB_MapMotorCharacter_OutTq_Rpm@ */ Lookup1D_WORD 0 RBM_CM_int16 -32768 32767
 /begin AXIS_DESCR COM_AXIS V_InRBM_MtrSpd_s16_Rpm RBM_CM_int16 9 -32768 32767 AXIS_PTS_REF K_RB_MapMotorCharacter_InSpd_Rpm /end AXIS_DESCR
/end CHARACTERISTIC
/begin AXIS_PTS K_RB_MapMotorCharacter_InSpd_Rpm "" 0x0000 /* @ECU_Address@K_RB_MapMotorCharacter_InSpd_Rpm@ */ V_InRBM_MtrSpd_s16_Rpm Lookup1D_X_WORD 0 RBM_CM_int16 9 -32768 32767 /end AXIS_PTS
/begin CHARACTERISTIC K_RB_MapVCUCoastTorq_0P1Nm "" CURVE 0x0000 /* @ECU_Address@K_RB_MapVCUCoastTorq_0P1Nm@ */ Lookup1D_WORD 0 RBM_CM_int16 -32768 32767
 /begin AXIS_DESCR COM_AXIS V_InRBM_CoastLvl_u8_Mode RBM_CM_uint8 5 0 255 AXIS_PTS_REF K_RB_MapVCUCoastLevelIn_u8 /end AXIS_DESCR
/end CHARACTERISTIC
/begin AXIS_PTS K_RB_MapVCUCoastLevelIn_u8 "" 0x0000 /* @ECU_Address@K_RB_MapVCUCoastLevelIn_u8@ */ V_InRBM_CoastLvl_u8_Mode Lookup1D_X_UBYTE 0 RBM_CM_uint8 5 0 255 /end AXIS_PTS
/begin CHARACTERISTIC K_RB_MapCoastDown_OutTq_0P1Nm "" CURVE 0x0000 /* @ECU_Address@K_RB_MapCoastDown_OutTq_0P1Nm@ */ Lookup1D_WORD 0 RBM_CM_int16 -32768 32767
 /begin AXIS_DESCR COM_AXIS V_InRBM_MtrSpd_s16_Rpm RBM_CM_int16 5 -32768 32767 AXIS_PTS_REF K_RB_MapCoastDown_InSpd_rpm /end AXIS_DESCR
/end CHARACTERISTIC
/begin AXIS_PTS K_RB_MapCoastDown_InSpd_rpm "" 0x0000 /* @ECU_Address@K_RB_MapCoastDown_InSpd_rpm@ */ V_InRBM_MtrSpd_s16_Rpm Lookup1D_X_WORD 0 RBM_CM_int16 5 -32768 32767 /end AXIS_PTS
/begin CHARACTERISTIC K_RB_MapQuitMotorSpd_OutSpd_Rpm "" CURVE 0x0000 /* @ECU_Address@K_RB_MapQuitMotorSpd_OutSpd_Rpm@ */ Lookup1D_WORD 0 RBM_CM_int16 -32768 32767
 /begin AXIS_DESCR COM_AXIS V_InRBM_PTar_s16s7_Bar RBM_CM_sfix16_En7 13 -256.0 255.9921875 AXIS_PTS_REF K_RB_MapQuitMotorSpd_InP_s16En7Bar /end AXIS_DESCR
/end CHARACTERISTIC
/begin AXIS_PTS K_RB_MapQuitMotorSpd_InP_s16En7Bar "" 0x0000 /* @ECU_Address@K_RB_MapQuitMotorSpd_InP_s16En7Bar@ */ V_InRBM_PTar_s16s7_Bar Lookup1D_X_WORD 0 RBM_CM_sfix16_En7 13 -256.0 255.9921875 /end AXIS_PTS
/begin CHARACTERISTIC K_RB_MapCoastTorqIncrementCoffe "" MAP 0x0000 /* @ECU_Address@K_RB_MapCoastTorqIncrementCoffe@ */ Lookup2D_WORD 0 RBM_CM_int16 -32768 32767
 /begin AXIS_DESCR /* Description of Y-Axis Points */ COM_AXIS V_InRBM_CoastLvl_u8_Mode RBM_CM_uint8 5 0 255 AXIS_PTS_REF K_RB_MapVCUCoastLevelIn_u8 /end AXIS_DESCR
 /begin AXIS_DESCR COM_AXIS V_InRBM_PTar_s16s7_Bar RBM_CM_sfix16_En7 11 -256.0 255.9921875 AXIS_PTS_REF K_RB_MapTorqCompensationPoint_s16En7Bar /end AXIS_DESCR
/end CHARACTERISTIC
/begin AXIS_PTS K_RB_MapTorqCompensationPoint_s16En7Bar "" 0x0000 /* @ECU_Address@K_RB_MapTorqCompensationPoint_s16En7Bar@ */ V_InRBM_PTar_s16s7_Bar Lookup2D_X_WORD 0 RBM_CM_sfix16_En7 11 -256.0 255.9921875 /end AXIS_PTS
/begin CHARACTERISTIC K_RB_MapPrefillForcePressure_OutP_s16En7Bar "" CURVE 0x0000 /* @ECU_Address@K_RB_MapPrefillForcePressure_OutP_s16En7Bar@ */ Lookup1D_WORD 0 RBM_CM_sfix16_En7 -256.0 255.9921875
 /begin AXIS_DESCR COM_AXIS V_InRBM_PTar_s16s7_Bar RBM_CM_sfix16_En7 13 -256.0 255.9921875 AXIS_PTS_REF K_RB_MapPrefillForcePressure_InP_s16En7Bar /end AXIS_DESCR
/end CHARACTERISTIC
/begin AXIS_PTS K_RB_MapPrefillForcePressure_InP_s16En7Bar "" 0x0000 /* @ECU_Address@K_RB_MapPrefillForcePressure_InP_s16En7Bar@ */ V_InRBM_PTar_s16s7_Bar Lookup1D_X_WORD 0 RBM_CM_sfix16_En7 13 -256.0 255.9921875 /end AXIS_PTS
/begin CHARACTERISTIC K_RB_PBrkCoeff_s16s10_null "" CURVE 0x0000 /* @ECU_Address@K_RB_PBrkCoeff_s16s10_null@ */ Lookup1D_WORD 0 RBM_CM_sfix16_En10 -32.0 31.9990234375
 /begin AXIS_DESCR COM_AXIS V_InRBM_PAct_s16s7_Bar RBM_CM_sfix16_En7 6 -256.0 255.9921875 AXIS_PTS_REF M_RB_BreakPntOfPAct_s16s7_Bar /end AXIS_DESCR
/end CHARACTERISTIC
/begin AXIS_PTS M_RB_BreakPntOfPAct_s16s7_Bar "" 0x0000 /* @ECU_Address@M_RB_BreakPntOfPAct_s16s7_Bar@ */ V_InRBM_PAct_s16s7_Bar Lookup1D_X_WORD 0 RBM_CM_sfix16_En7 6 -256.0 255.9921875 /end AXIS_PTS
/begin CHARACTERISTIC K_RB_MapQuitdP2dPGain_OutP_s16En7 "" CURVE 0x0000 /* @ECU_Address@K_RB_MapQuitdP2dPGain_OutP_s16En7@ */ Lookup1D_WORD 0 RBM_CM_sfix16_En7 -256.0 255.9921875
 /begin AXIS_DESCR COM_AXIS V_InRBM_PTar_s16s7_Bar RBM_CM_sfix16_En7 13 -256.0 255.9921875 AXIS_PTS_REF K_RB_MapQuitdP2dPGain_InP_s16En7Bar /end AXIS_DESCR
/end CHARACTERISTIC
/begin AXIS_PTS K_RB_MapQuitdP2dPGain_InP_s16En7Bar "" 0x0000 /* @ECU_Address@K_RB_MapQuitdP2dPGain_InP_s16En7Bar@ */ V_InRBM_PTar_s16s7_Bar Lookup1D_X_WORD 0 RBM_CM_sfix16_En7 13 -256.0 255.9921875 /end AXIS_PTS
/begin CHARACTERISTIC K_RB_MapQuitdP2dPOffset_OutP_s16En7Bar "" CURVE 0x0000 /* @ECU_Address@K_RB_MapQuitdP2dPOffset_OutP_s16En7Bar@ */ Lookup1D_WORD 0 RBM_CM_sfix16_En7 -256.0 255.9921875
 /begin AXIS_DESCR COM_AXIS V_InRBM_PTar_s16s7_Bar RBM_CM_sfix16_En7 13 -256.0 255.9921875 AXIS_PTS_REF K_RB_MapQuitdP2dPOffset_InP_s16En7Bar /end AXIS_DESCR
/end CHARACTERISTIC
/begin AXIS_PTS K_RB_MapQuitdP2dPOffset_InP_s16En7Bar "" 0x0000 /* @ECU_Address@K_RB_MapQuitdP2dPOffset_InP_s16En7Bar@ */ V_InRBM_PTar_s16s7_Bar Lookup1D_X_WORD 0 RBM_CM_sfix16_En7 13 -256.0 255.9921875 /end AXIS_PTS
/begin CHARACTERISTIC K_RB_MapQuitTqDelay_Out_5ms "" CURVE 0x0000 /* @ECU_Address@K_RB_MapQuitTqDelay_Out_5ms@ */ Lookup1D_UBYTE 0 RBM_CM_uint8 0 255
 /begin AXIS_DESCR COM_AXIS V_InRBM_PTar_s16s7_Bar RBM_CM_sfix16_En7 13 -256.0 255.9921875 AXIS_PTS_REF K_RB_MapQuitTqDelay_InP_s16En7Bar /end AXIS_DESCR
/end CHARACTERISTIC
/begin AXIS_PTS K_RB_MapQuitTqDelay_InP_s16En7Bar "" 0x0000 /* @ECU_Address@K_RB_MapQuitTqDelay_InP_s16En7Bar@ */ V_InRBM_PTar_s16s7_Bar Lookup1D_X_WORD 0 RBM_CM_sfix16_En7 13 -256.0 255.9921875 /end AXIS_PTS
/begin CHARACTERISTIC K_RB_MutiMapStepPressure_OutP_s16En7Bar "" MAP 0x0000 /* @ECU_Address@K_RB_MutiMapStepPressure_OutP_s16En7Bar@ */ Lookup2D_WORD 0 RBM_CM_sfix16_En7 -256.0 255.9921875
 /begin AXIS_DESCR /* Description of Y-Axis Points */ COM_AXIS V_InRBM_PTar_s16s7_Bar RBM_CM_sfix16_En7 13 -256.0 255.9921875 AXIS_PTS_REF K_RB_MapStepPressure_InP_s16En7Bar /end AXIS_DESCR
 /begin AXIS_DESCR COM_AXIS NO_INPUT_QUANTITY RBM_CM_int16 5 -32768 32767 AXIS_PTS_REF K_RB_MapStepPressure_InTq_s16_0P1Nm /end AXIS_DESCR
/end CHARACTERISTIC
/begin AXIS_PTS K_RB_MapStepPressure_InTq_s16_0P1Nm "" 0x0000 /* @ECU_Address@K_RB_MapStepPressure_InTq_s16_0P1Nm@ */ NO_INPUT_QUANTITY Lookup2D_X_WORD 0 RBM_CM_int16 5 -32768 32767 /end AXIS_PTS
/begin AXIS_PTS K_RB_MapStepPressure_InP_s16En7Bar "" 0x0000 /* @ECU_Address@K_RB_MapStepPressure_InP_s16En7Bar@ */ V_InRBM_PTar_s16s7_Bar Lookup2D_X_WORD 0 RBM_CM_sfix16_En7 13 -256.0 255.9921875 /end AXIS_PTS
/begin CHARACTERISTIC K_RB_MapStepPressure_OutP_s16En7Bar "" CURVE 0x0000 /* @ECU_Address@K_RB_MapStepPressure_OutP_s16En7Bar@ */ Lookup1D_WORD 0 RBM_CM_sfix16_En7 -256.0 255.9921875
 /begin AXIS_DESCR COM_AXIS V_InRBM_PTar_s16s7_Bar RBM_CM_sfix16_En7 13 -256.0 255.9921875 AXIS_PTS_REF K_RB_MapStepPressure_InP_s16En7Bar /end AXIS_DESCR
/end CHARACTERISTIC
/begin CHARACTERISTIC K_RB_CutInMotorSpdDelta_Rpm "" VALUE 0x0000 /* @ECU_Address@K_RB_CutInMotorSpdDelta_Rpm@ */ Scalar_SWORD 0 RBM_CM_int16 -32768 32767 /end CHARACTERISTIC
/begin CHARACTERISTIC K_RB_CutInPdlStk_Pct "" VALUE 0x0000 /* @ECU_Address@K_RB_CutInPdlStk_Pct@ */ Scalar_SWORD 0 RBM_CM_int16 -32768 32767 /end CHARACTERISTIC
/begin CHARACTERISTIC K_RB_CutOutMotorSpd_Rpm "" VALUE 0x0000 /* @ECU_Address@K_RB_CutOutMotorSpd_Rpm@ */ Scalar_SWORD 0 RBM_CM_int16 -32768 32767 /end CHARACTERISTIC
/begin CHARACTERISTIC K_RB_MtrSpdQuitStop_s16_Rpm "" VALUE 0x0000 /* @ECU_Address@K_RB_MtrSpdQuitStop_s16_Rpm@ */ Scalar_SWORD 0 RBM_CM_int16 -32768 32767 /end CHARACTERISTIC
/begin CHARACTERISTIC K_RB_P2TqOffset_null "" VALUE 0x0000 /* @ECU_Address@K_RB_P2TqOffset_null@ */ Scalar_SWORD 0 RBM_CM_int16 -32768 32767 /end CHARACTERISTIC
/begin CHARACTERISTIC K_RB_PrefillCutInMotorSpdDelta_Rpm "" VALUE 0x0000 /* @ECU_Address@K_RB_PrefillCutInMotorSpdDelta_Rpm@ */ Scalar_SWORD 0 RBM_CM_int16 -32768 32767 /end CHARACTERISTIC
/begin CHARACTERISTIC K_RB_TorqueErrorThreshold_0P1Nm "" VALUE 0x0000 /* @ECU_Address@K_RB_TorqueErrorThreshold_0P1Nm@ */ Scalar_SWORD 0 RBM_CM_int16 -32768 32767 /end CHARACTERISTIC
/begin CHARACTERISTIC K_RB_TorqueErrorTimeThreshold_5ms "" VALUE 0x0000 /* @ECU_Address@K_RB_TorqueErrorTimeThreshold_5ms@ */ Scalar_SWORD 0 RBM_CM_int16 -32768 32767 /end CHARACTERISTIC
/begin CHARACTERISTIC K_RB_TqQuitStop_s16_0P1Nm "" VALUE 0x0000 /* @ECU_Address@K_RB_TqQuitStop_s16_0P1Nm@ */ Scalar_SWORD 0 RBM_CM_int16 -32768 32767 /end CHARACTERISTIC
/begin CHARACTERISTIC K_RB_WheelSpdThreshold_kph "" VALUE 0x0000 /* @ECU_Address@K_RB_WheelSpdThreshold_kph@ */ Scalar_SWORD 0 RBM_CM_int16 -32768 32767 /end CHARACTERISTIC
/begin CHARACTERISTIC K_RBM_AbsDlyP_s16s7_Bar "" VALUE 0x0000 /* @ECU_Address@K_RBM_AbsDlyP_s16s7_Bar@ */ Scalar_SWORD 0 RBM_CM_sfix16_En7 -256.0 255.9921875 /end CHARACTERISTIC
/begin CHARACTERISTIC K_RB_ABSStepP_s16En7Bar "" VALUE 0x0000 /* @ECU_Address@K_RB_ABSStepP_s16En7Bar@ */ Scalar_SWORD 0 RBM_CM_sfix16_En7 -256.0 255.9921875 /end CHARACTERISTIC
/begin CHARACTERISTIC K_RB_FastQuitSpdOfSts1_s16s7_Bar "" VALUE 0x0000 /* @ECU_Address@K_RB_FastQuitSpdOfSts1_s16s7_Bar@ */ Scalar_SWORD 0 RBM_CM_sfix16_En7 -256.0 255.9921875 /end CHARACTERISTIC
/begin CHARACTERISTIC K_RB_OutPMinPressure_s16En7Bar "" VALUE 0x0000 /* @ECU_Address@K_RB_OutPMinPressure_s16En7Bar@ */ Scalar_SWORD 0 RBM_CM_sfix16_En7 -256.0 255.9921875 /end CHARACTERISTIC
/begin CHARACTERISTIC K_RB_P2TqGain_null "" VALUE 0x0000 /* @ECU_Address@K_RB_P2TqGain_null@ */ Scalar_SWORD 0 RBM_CM_sfix16_En7 -256.0 255.9921875 /end CHARACTERISTIC
/begin CHARACTERISTIC K_RB_SlowQuitSpdOfSts1_s16s7_Bar "" VALUE 0x0000 /* @ECU_Address@K_RB_SlowQuitSpdOfSts1_s16s7_Bar@ */ Scalar_SWORD 0 RBM_CM_sfix16_En7 -256.0 255.9921875 /end CHARACTERISTIC
/begin CHARACTERISTIC K_RB_Q2DDelay_u8_5ms "" VALUE 0x0000 /* @ECU_Address@K_RB_Q2DDelay_u8_5ms@ */ Scalar_UWORD 0 RBM_CM_uint16 0 65535 /end CHARACTERISTIC
/begin CHARACTERISTIC K_RBM_TotFctEna_u8_Flg "" VALUE 0x0000 /* @ECU_Address@K_RBM_TotFctEna_u8_Flg@ */ Scalar_UBYTE 0 RBM_CM_uint8 0 255 /end CHARACTERISTIC
/begin CHARACTERISTIC K_RB_ABSDelay_Disable "" VALUE 0x0000 /* @ECU_Address@K_RB_ABSDelay_Disable@ */ Scalar_UBYTE 0 RBM_CM_uint8 0 255 /end CHARACTERISTIC
/begin CHARACTERISTIC K_RB_AbsActvCoastCnclEna_u8_Flg "" VALUE 0x0000 /* @ECU_Address@K_RB_AbsActvCoastCnclEna_u8_Flg@ */ Scalar_UBYTE 0 RBM_CM_uint8 0 255 /end CHARACTERISTIC
/begin CHARACTERISTIC K_RB_DiagAssistant_Ena "" VALUE 0x0000 /* @ECU_Address@K_RB_DiagAssistant_Ena@ */ Scalar_UBYTE 0 RBM_CM_uint8 0 255 /end CHARACTERISTIC
/begin CHARACTERISTIC K_RB_ForceDisable_Ena "" VALUE 0x0000 /* @ECU_Address@K_RB_ForceDisable_Ena@ */ Scalar_UBYTE 0 RBM_CM_uint8 0 255 /end CHARACTERISTIC
/begin CHARACTERISTIC K_RB_ForceQuit_Ena "" VALUE 0x0000 /* @ECU_Address@K_RB_ForceQuit_Ena@ */ Scalar_UBYTE 0 RBM_CM_uint8 0 255 /end CHARACTERISTIC
/begin CHARACTERISTIC K_RB_FullChargeQuit_Disable "" VALUE 0x0000 /* @ECU_Address@K_RB_FullChargeQuit_Disable@ */ Scalar_UBYTE 0 RBM_CM_uint8 0 255 /end CHARACTERISTIC
/begin CHARACTERISTIC K_RB_GearOverride_Ena "" VALUE 0x0000 /* @ECU_Address@K_RB_GearOverride_Ena@ */ Scalar_UBYTE 0 RBM_CM_uint8 0 255 /end CHARACTERISTIC
/begin CHARACTERISTIC K_RB_GearOverride_Flg "" VALUE 0x0000 /* @ECU_Address@K_RB_GearOverride_Flg@ */ Scalar_UBYTE 0 RBM_CM_uint8 0 255 /end CHARACTERISTIC
/begin CHARACTERISTIC K_RB_MultiCoastTenseEna_u8_Flg "" VALUE 0x0000 /* @ECU_Address@K_RB_MultiCoastTenseEna_u8_Flg@ */ Scalar_UBYTE 0 RBM_CM_uint8 0 255 /end CHARACTERISTIC
/begin CHARACTERISTIC K_RB_Prefill_Ena "" VALUE 0x0000 /* @ECU_Address@K_RB_Prefill_Ena@ */ Scalar_UBYTE 0 RBM_CM_uint8 0 255 /end CHARACTERISTIC
/begin MEASUREMENT V_InRBM_EhbErrMod_u8_Mode "0: no err
      1: degraded
      2: broken" UBYTE RBM_CM_uint8 0 0 0.0 6.0 ECU_ADDRESS 0x0000 /* @ECU_Address@V_InRBM_EhbErrMod_u8_Mode@ */ /end MEASUREMENT
/begin MEASUREMENT V_InRBM_PTar_s16s7_Bar "" SWORD RBM_CM_sfix16_En7 0 0 0.0 150.0 ECU_ADDRESS 0x0000 /* @ECU_Address@V_InRBM_PTar_s16s7_Bar@ */ /end MEASUREMENT
/begin MEASUREMENT V_InRBM_PAct_s16s7_Bar "" SWORD RBM_CM_sfix16_En7 0 0 0.0 150.0 ECU_ADDRESS 0x0000 /* @ECU_Address@V_InRBM_PAct_s16s7_Bar@ */ /end MEASUREMENT
/begin MEASUREMENT V_InRBM_BrkPdlStk_s16s5_mm "" SWORD RBM_CM_sfix16_En5 0 0 0.0 50.0 ECU_ADDRESS 0x0000 /* @ECU_Address@V_InRBM_BrkPdlStk_s16s5_mm@ */ /end MEASUREMENT
/begin MEASUREMENT V_InRBM_RbmEnaFromVcu_u8_Flg "" UBYTE RBM_CM_uint8 0 0 0.0 1.0 ECU_ADDRESS 0x0000 /* @ECU_Address@V_InRBM_RbmEnaFromVcu_u8_Flg@ */ /end MEASUREMENT
/begin MEASUREMENT V_InRBM_GasPdlStk_s16_Perc "" SWORD RBM_CM_int16 0 0 0.0 100.0 ECU_ADDRESS 0x0000 /* @ECU_Address@V_InRBM_GasPdlStk_s16_Perc@ */ /end MEASUREMENT
/begin MEASUREMENT V_InRBM_GasPdlStk_u8_Vld "" UBYTE RBM_CM_uint8 0 0 0.0 2.0 ECU_ADDRESS 0x0000 /* @ECU_Address@V_InRBM_GasPdlStk_u8_Vld@ */ /end MEASUREMENT
/begin MEASUREMENT V_InRBM_MtrTqLim_s16_0P1Nm "" SWORD RBM_CM_int16 0 0 0.0 100.0 ECU_ADDRESS 0x0000 /* @ECU_Address@V_InRBM_MtrTqLim_s16_0P1Nm@ */ /end MEASUREMENT
/begin MEASUREMENT V_InRBM_MtrTqLim_u8_Vld "" UBYTE RBM_CM_uint8 0 0 0.0 100.0 ECU_ADDRESS 0x0000 /* @ECU_Address@V_InRBM_MtrTqLim_u8_Vld@ */ /end MEASUREMENT
/begin MEASUREMENT V_InRBM_PtMinorFlt_u8_Err "" UBYTE RBM_CM_uint8 0 0 0.0 1.0 ECU_ADDRESS 0x0000 /* @ECU_Address@V_InRBM_PtMinorFlt_u8_Err@ */ /end MEASUREMENT
/begin MEASUREMENT V_InRBM_PtSevereFlt_u8_Err "" UBYTE RBM_CM_uint8 0 0 0.0 1.0 ECU_ADDRESS 0x0000 /* @ECU_Address@V_InRBM_PtSevereFlt_u8_Err@ */ /end MEASUREMENT
/begin MEASUREMENT V_InRBM_GearPosnAct_u8_Mode "" UBYTE RBM_CM_uint8 0 0 0.0 1.0 ECU_ADDRESS 0x0000 /* @ECU_Address@V_InRBM_GearPosnAct_u8_Mode@ */ /end MEASUREMENT
/begin MEASUREMENT V_InRBM_AbsActv_u8_Flg "" UBYTE RBM_CM_uint8 0 0 0.0 1.0 ECU_ADDRESS 0x0000 /* @ECU_Address@V_InRBM_AbsActv_u8_Flg@ */ /end MEASUREMENT
/begin MEASUREMENT V_InRBM_BmsI_s16_0P1A "" SWORD RBM_CM_int16 0 0 0.0 1.0 ECU_ADDRESS 0x0000 /* @ECU_Address@V_InRBM_BmsI_s16_0P1A@ */ /end MEASUREMENT
/begin MEASUREMENT V_InRBM_BmsU_s16_0P1V "" SWORD RBM_CM_int16 0 0 0.0 5000.0 ECU_ADDRESS 0x0000 /* @ECU_Address@V_InRBM_BmsU_s16_0P1V@ */ /end MEASUREMENT
/begin MEASUREMENT V_InRBM_EpsSteerAg_s16_Deg "" SWORD RBM_CM_int16 0 0 0.0 100.0 ECU_ADDRESS 0x0000 /* @ECU_Address@V_InRBM_EpsSteerAg_s16_Deg@ */ /end MEASUREMENT
/begin MEASUREMENT V_InRBM_EpsSteerAg_u8_Vld "" UBYTE RBM_CM_uint8 0 0 0.0 100.0 ECU_ADDRESS 0x0000 /* @ECU_Address@V_InRBM_EpsSteerAg_u8_Vld@ */ /end MEASUREMENT
/begin MEASUREMENT V_InRBM_ChassisFlt_u8_Err "" UBYTE RBM_CM_uint8 0 0 0.0 1.0 ECU_ADDRESS 0x0000 /* @ECU_Address@V_InRBM_ChassisFlt_u8_Err@ */ /end MEASUREMENT
/begin MEASUREMENT V_InRBM_MtrSpd_s16_Rpm "" SWORD RBM_CM_int16 0 0 0.0 100.0 ECU_ADDRESS 0x0000 /* @ECU_Address@V_InRBM_MtrSpd_s16_Rpm@ */ /end MEASUREMENT
/begin MEASUREMENT V_InRBM_MtrSpd_u8_Vld "" UBYTE RBM_CM_uint8 0 0 0.0 100.0 ECU_ADDRESS 0x0000 /* @ECU_Address@V_InRBM_MtrSpd_u8_Vld@ */ /end MEASUREMENT
/begin MEASUREMENT V_InRBM_MtrTqAct_s16_0P1Nm "" SWORD RBM_CM_int16 0 0 0.0 100.0 ECU_ADDRESS 0x0000 /* @ECU_Address@V_InRBM_MtrTqAct_s16_0P1Nm@ */ /end MEASUREMENT
/begin MEASUREMENT V_InRBM_MtrTqAct_u8_Vld "" UBYTE RBM_CM_uint8 0 0 0.0 100.0 ECU_ADDRESS 0x0000 /* @ECU_Address@V_InRBM_MtrTqAct_u8_Vld@ */ /end MEASUREMENT
/begin MEASUREMENT V_InRBM_LostChassisCan_u8_Err "" UBYTE RBM_CM_uint8 0 0 0.0 100.0 ECU_ADDRESS 0x0000 /* @ECU_Address@V_InRBM_LostChassisCan_u8_Err@ */ /end MEASUREMENT
/begin MEASUREMENT V_InRBM_LostPtCan_u8_Err "" UBYTE RBM_CM_uint8 0 0 0.0 100.0 ECU_ADDRESS 0x0000 /* @ECU_Address@V_InRBM_LostPtCan_u8_Err@ */ /end MEASUREMENT
/begin MEASUREMENT V_InRBM_VehSpd_s16_0P1Kph "" SWORD RBM_CM_int16 0 0 0.0 1.0 ECU_ADDRESS 0x0000 /* @ECU_Address@V_InRBM_VehSpd_s16_0P1Kph@ */ /end MEASUREMENT
/begin MEASUREMENT V_InRBM_VehSpd_u8_Vld "" UBYTE RBM_CM_uint8 0 0 0.0 100.0 ECU_ADDRESS 0x0000 /* @ECU_Address@V_InRBM_VehSpd_u8_Vld@ */ /end MEASUREMENT
/begin MEASUREMENT V_InRBM_FLWhlSpd_s16_0P1Kph "" SWORD RBM_CM_int16 0 0 0.0 100.0 ECU_ADDRESS 0x0000 /* @ECU_Address@V_InRBM_FLWhlSpd_s16_0P1Kph@ */ /end MEASUREMENT
/begin MEASUREMENT V_InRBM_FRWhlSpd_s16_0P1Kph "" SWORD RBM_CM_int16 0 0 0.0 100.0 ECU_ADDRESS 0x0000 /* @ECU_Address@V_InRBM_FRWhlSpd_s16_0P1Kph@ */ /end MEASUREMENT
/begin MEASUREMENT V_InRBM_RLWhlSpd_s16_0P1Kph "" SWORD RBM_CM_int16 0 0 0.0 100.0 ECU_ADDRESS 0x0000 /* @ECU_Address@V_InRBM_RLWhlSpd_s16_0P1Kph@ */ /end MEASUREMENT
/begin MEASUREMENT V_InRBM_RRWhlSpd_s16_0P1Kph "" SWORD RBM_CM_int16 0 0 0.0 100.0 ECU_ADDRESS 0x0000 /* @ECU_Address@V_InRBM_RRWhlSpd_s16_0P1Kph@ */ /end MEASUREMENT
/begin MEASUREMENT V_InRBM_CoastLvl_u8_Mode "" UBYTE RBM_CM_uint8 0 0 0.0 1.0 ECU_ADDRESS 0x0000 /* @ECU_Address@V_InRBM_CoastLvl_u8_Mode@ */ /end MEASUREMENT
/begin MEASUREMENT dAimP "" SWORD RBM_CM_sfix16_En7 0 0 -256.0 255.9921875 ECU_ADDRESS 0x0000 /* @ECU_Address@dAimP@ */ /end MEASUREMENT
/begin MEASUREMENT V_RBM_PTarFormer_s16s7_Bar "" SWORD RBM_CM_sfix16_En7 0 0 -256.0 255.9921875 ECU_ADDRESS 0x0000 /* @ECU_Address@V_RBM_PTarFormer_s16s7_Bar@ */ /end MEASUREMENT
/begin MEASUREMENT V_OutRBM_PTar_s16s7_Bar "" SWORD RBM_CM_sfix16_En7 0 0 -256.0 255.9921875 ECU_ADDRESS 0x0000 /* @ECU_Address@V_OutRBM_PTar_s16s7_Bar@ */ /end MEASUREMENT
/begin MEASUREMENT V_RB_dpQuitMod_s16s7_Bar "" SWORD RBM_CM_sfix16_En7 0 0 -256.0 255.9921875 ECU_ADDRESS 0x0000 /* @ECU_Address@V_RB_dpQuitMod_s16s7_Bar@ */ /end MEASUREMENT
/begin MEASUREMENT dPQuit "" SWORD RBM_CM_sfix16_En7 0 0 -256.0 255.9921875 ECU_ADDRESS 0x0000 /* @ECU_Address@dPQuit@ */ /end MEASUREMENT
/begin MEASUREMENT V_RBM_MtrTqCoast_s16_0P1Nm "" SWORD RBM_CM_int16 0 0 -32768 32767 ECU_ADDRESS 0x0000 /* @ECU_Address@V_RBM_MtrTqCoast_s16_0P1Nm@ */ /end MEASUREMENT
/begin MEASUREMENT V_RBM_MtrTqTarFormer_s16_0P1Nm "" SWORD RBM_CM_int16 0 0 -32768 32767 ECU_ADDRESS 0x0000 /* @ECU_Address@V_RBM_MtrTqTarFormer_s16_0P1Nm@ */ /end MEASUREMENT
/begin MEASUREMENT V_RBM_MtrTqAllwd_s16_0P1Nm "" SWORD RBM_CM_int16 0 0 -32768 32767 ECU_ADDRESS 0x0000 /* @ECU_Address@V_RBM_MtrTqAllwd_s16_0P1Nm@ */ /end MEASUREMENT
/begin MEASUREMENT V_RBM_DTqQuitMode_s16_0P1Nm "" SWORD RBM_CM_int16 0 0 -32768 32767 ECU_ADDRESS 0x0000 /* @ECU_Address@V_RBM_DTqQuitMode_s16_0P1Nm@ */ /end MEASUREMENT
/begin MEASUREMENT V_RBM_DiagInfo1_u16_Mode "" SWORD RBM_CM_int16 0 0 -32768 32767 ECU_ADDRESS 0x0000 /* @ECU_Address@V_RBM_DiagInfo1_u16_Mode@ */ /end MEASUREMENT
/begin MEASUREMENT V_RBM_DiagInfo2_u16_Mode "" SWORD RBM_CM_int16 0 0 -32768 32767 ECU_ADDRESS 0x0000 /* @ECU_Address@V_RBM_DiagInfo2_u16_Mode@ */ /end MEASUREMENT
/begin MEASUREMENT V_OutRBM_MtrTqTar_s16_0P1Nm "" SWORD RBM_CM_int16 0 0 -32768 32767 ECU_ADDRESS 0x0000 /* @ECU_Address@V_OutRBM_MtrTqTar_s16_0P1Nm@ */ /end MEASUREMENT
/begin MEASUREMENT V_RBM_FormerTorqueErrorOver_u8_Err "" UBYTE RBM_CM_uint8 0 0 0 255 ECU_ADDRESS 0x0000 /* @ECU_Address@V_RBM_FormerTorqueErrorOver_u8_Err@ */ /end MEASUREMENT
/begin MEASUREMENT V_RB_RBModeMask_Flg "" UBYTE RBM_CM_uint8 0 0 0 255 ECU_ADDRESS 0x0000 /* @ECU_Address@V_RB_RBModeMask_Flg@ */ /end MEASUREMENT
/begin MEASUREMENT V_OutRBM_RbmActv_u8_Flg "" UBYTE RBM_CM_uint8 0 0 0 255 ECU_ADDRESS 0x0000 /* @ECU_Address@V_OutRBM_RbmActv_u8_Flg@ */ /end MEASUREMENT
/begin MEASUREMENT V_OutRBM_PreFillEna_u8_Flg "" UBYTE RBM_CM_uint8 0 0 0 255 ECU_ADDRESS 0x0000 /* @ECU_Address@V_OutRBM_PreFillEna_u8_Flg@ */ /end MEASUREMENT
/begin MEASUREMENT V_OutRBM_TqErrOver_u8_Err "" UBYTE RBM_CM_uint8 0 0 0 255 ECU_ADDRESS 0x0000 /* @ECU_Address@V_OutRBM_TqErrOver_u8_Err@ */ /end MEASUREMENT
/begin MEASUREMENT V_OutRBM_MtrTqFolwReq_u8_Flg "" UBYTE RBM_CM_uint8 0 0 0 255 ECU_ADDRESS 0x0000 /* @ECU_Address@V_OutRBM_MtrTqFolwReq_u8_Flg@ */ /end MEASUREMENT
/begin MEASUREMENT RB_Ver "" UBYTE RBM_CM_uint8 0 0 0 255 /* Array Size */ ARRAY_SIZE 9 ECU_ADDRESS 0x0000 /* @ECU_Address@RB_Ver@ */ /end MEASUREMENT
/begin MEASUREMENT V_RBM_DiModSts_u8_Mode "" UBYTE RBM_CM_uint8 0 0 0 255 ECU_ADDRESS 0x0000 /* @ECU_Address@V_RBM_DiModSts_u8_Mode@ */ /end MEASUREMENT
/begin MEASUREMENT V_RBM_WhlSpdSlip_u8_Err "" UBYTE RBM_CM_uint8 0 0 0 255 ECU_ADDRESS 0x0000 /* @ECU_Address@V_RBM_WhlSpdSlip_u8_Err@ */ /end MEASUREMENT
/begin MEASUREMENT V_RB_RBState_Flg "" UBYTE RBM_CM_uint8 0 0 0 255 ECU_ADDRESS 0x0000 /* @ECU_Address@V_RB_RBState_Flg@ */ /end MEASUREMENT
/begin COMPU_METHOD RBM_CM_sfix16_En7 "Q = V*128.000000" RAT_FUNC "%10.7" "" COEFFS 0 128.000000 0.000000 0 0 1.000000 /end COMPU_METHOD
/begin COMPU_METHOD RBM_CM_int16 "Q = V" RAT_FUNC "%5.0" "" COEFFS 0 1 0 0 0 1 /end COMPU_METHOD
/begin COMPU_METHOD RBM_CM_uint8 "Q = V" RAT_FUNC "%3.0" "" COEFFS 0 1 0 0 0 1 /end COMPU_METHOD
/begin COMPU_METHOD RBM_CM_sfix16_En10 "Q = V*1024.000000" RAT_FUNC "%12.10" "" COEFFS 0 1024.000000 0.000000 0 0 1.000000 /end COMPU_METHOD
/begin COMPU_METHOD RBM_CM_uint16 "Q = V" RAT_FUNC "%5.0" "" COEFFS 0 1 0 0 0 1 /end COMPU_METHOD
/begin COMPU_METHOD RBM_CM_sfix16_En5 "Q = V*32.000000" RAT_FUNC "%9.5" "" COEFFS 0 32.000000 0.000000 0 0 1.000000 /end COMPU_METHOD
/begin GROUP RBM "RBM" /* Root */ ROOT /begin SUB_GROUP Root_Subsystem /end SUB_GROUP
 /begin REF_MEASUREMENT V_InRBM_AbsActv_u8_Flg V_InRBM_BmsI_s16_0P1A V_InRBM_BmsU_s16_0P1V V_InRBM_BrkPdlStk_s16s5_mm V_InRBM_ChassisFlt_u8_Err V_InRBM_CoastLvl_u8_Mode V_InRBM_EhbErrMod_u8_Mode V_InRBM_EpsSteerAg_s16_Deg V_InRBM_EpsSteerAg_u8_Vld V_InRBM_FLWhlSpd_s16_0P1Kph V_InRBM_FRWhlSpd_s16_0P1Kph V_InRBM_GasPdlStk_s16_Perc V_InRBM_GasPdlStk_u8_Vld V_InRBM_GearPosnAct_u8_Mode V_InRBM_LostChassisCan_u8_Err V_InRBM_LostPtCan_u8_Err V_InRBM_MtrSpd_s16_Rpm V_InRBM_MtrSpd_u8_Vld V_InRBM_MtrTqAct_s16_0P1Nm V_InRBM_MtrTqAct_u8_Vld V_InRBM_MtrTqLim_s16_0P1Nm V_InRBM_MtrTqLim_u8_Vld V_InRBM_PAct_s16s7_Bar V_InRBM_PTar_s16s7_Bar V_InRBM_PtMinorFlt_u8_Err V_InRBM_PtSevereFlt_u8_Err V_InRBM_RLWhlSpd_s16_0P1Kph V_InRBM_RRWhlSpd_s16_0P1Kph V_InRBM_RbmEnaFromVcu_u8_Flg V_InRBM_VehSpd_s16_0P1Kph V_InRBM_VehSpd_u8_Vld /end REF_MEASUREMENT
/end GROUP
/begin GROUP Root_Subsystem "RBM/Subsystem"
 /begin SUB_GROUP S1_AllowMotorTorqueCalculator S1_CoastBrakeCalculator S1_Prefill_Ena S1_RB_Disable_Mode S1_RB_Enable_Mode S1_RB_Quit_Mode S1_RB_State_Judge S1_Subsystem S1_Subsystem2 S1_dAimP /end SUB_GROUP
 /begin REF_CHARACTERISTIC K_RBM_TotFctEna_u8_Flg /end REF_CHARACTERISTIC
 /begin REF_MEASUREMENT RB_Ver V_OutRBM_MtrTqFolwReq_u8_Flg V_OutRBM_MtrTqTar_s16_0P1Nm V_OutRBM_PTar_s16s7_Bar V_OutRBM_RbmActv_u8_Flg V_OutRBM_TqErrOver_u8_Err V_RBM_FormerTorqueErrorOver_u8_Err V_RBM_MtrTqTarFormer_s16_0P1Nm V_RBM_PTarFormer_s16s7_Bar /end REF_MEASUREMENT
/end GROUP
/begin GROUP S1_AllowMotorTorqueCalculator "RBM/Subsystem/AllowMotorTorqueCalculator" /begin SUB_GROUP S3_p2tq S3_p2tq1 /end SUB_GROUP
 /begin REF_CHARACTERISTIC K_RB_EPSLimitTorqueMap_Tq_0P1Nm K_RB_MapMotorCharacter_OutTq_Rpm K_RB_MapP2PDecouple_OutP_s16En7Bar K_RB_MapS2PDecouple_OutP_s16En7Bar /end REF_CHARACTERISTIC
 /begin REF_MEASUREMENT V_RBM_MtrTqAllwd_s16_0P1Nm /end REF_MEASUREMENT
/end GROUP
/begin GROUP S1_CoastBrakeCalculator "RBM/Subsystem/CoastBrakeCalculator"
 /begin REF_CHARACTERISTIC K_RB_MapCoastDown_OutTq_0P1Nm K_RB_MapVCUCoastTorq_0P1Nm K_RB_MultiCoastTenseEna_u8_Flg /end REF_CHARACTERISTIC
 /begin REF_MEASUREMENT V_RBM_MtrTqCoast_s16_0P1Nm /end REF_MEASUREMENT
/end GROUP
/begin GROUP S1_Prefill_Ena "RBM/Subsystem/Prefill_Ena" /begin REF_CHARACTERISTIC K_RB_Prefill_Ena /end REF_CHARACTERISTIC /begin REF_MEASUREMENT V_OutRBM_PreFillEna_u8_Flg /end REF_MEASUREMENT /end GROUP
/begin GROUP S1_RB_Disable_Mode "RBM/Subsystem/RB_Disable_Mode" /begin SUB_GROUP S8_Subsystem /end SUB_GROUP /begin REF_MEASUREMENT V_RBM_DiModSts_u8_Mode /end REF_MEASUREMENT /end GROUP
/begin GROUP S1_RB_Enable_Mode "RBM/Subsystem/RB_Enable_Mode" /begin SUB_GROUP S10_CoastCncl S10_RBEna_Signals /end SUB_GROUP /end GROUP
/begin GROUP S1_RB_Quit_Mode "RBM/Subsystem/RB_Quit_Mode" /begin SUB_GROUP S11_Subsystem1 S11_Subsystem2 /end SUB_GROUP /end GROUP
/begin GROUP S1_RB_State_Judge "RBM/Subsystem/RB_State_Judge" /begin SUB_GROUP S12_Diag S12_override /end SUB_GROUP
 /begin REF_CHARACTERISTIC K_RB_CutInMotorSpdDelta_Rpm K_RB_CutInPdlStk_Pct K_RB_CutOutMotorSpd_Rpm K_RB_DiagAssistant_Ena K_RB_ForceDisable_Ena K_RB_ForceQuit_Ena K_RB_MapQuitMotorSpd_OutSpd_Rpm K_RB_Q2DDelay_u8_5ms /end REF_CHARACTERISTIC
 /begin REF_MEASUREMENT V_RB_RBModeMask_Flg V_RB_RBState_Flg /end REF_MEASUREMENT
/end GROUP
/begin GROUP S1_Subsystem "RBM/Subsystem/Subsystem" /begin REF_CHARACTERISTIC K_RB_WheelSpdThreshold_kph /end REF_CHARACTERISTIC /begin REF_MEASUREMENT V_RBM_WhlSpdSlip_u8_Err /end REF_MEASUREMENT /end GROUP
/begin GROUP S1_Subsystem2 "RBM/Subsystem/Subsystem2" /begin REF_CHARACTERISTIC K_RB_OutPMinPressure_s16En7Bar /end REF_CHARACTERISTIC /end GROUP
/begin GROUP S1_dAimP "RBM/Subsystem/dAimP" /begin REF_MEASUREMENT dAimP /end REF_MEASUREMENT /end GROUP
/begin GROUP S3_p2tq "RBM/Subsystem/AllowMotorTorqueCalculator/p2tq" /begin REF_CHARACTERISTIC K_RB_P2TqGain_null K_RB_P2TqOffset_null /end REF_CHARACTERISTIC /end GROUP
/begin GROUP S3_p2tq1 "RBM/Subsystem/AllowMotorTorqueCalculator/p2tq1" /begin REF_CHARACTERISTIC K_RB_P2TqGain_null K_RB_P2TqOffset_null /end REF_CHARACTERISTIC /end GROUP
/begin GROUP S8_Subsystem "RBM/Subsystem/RB_Disable_Mode/Subsystem"
 /begin REF_CHARACTERISTIC K_RB_FastQuitSpdOfSts1_s16s7_Bar K_RB_P2TqGain_null K_RB_SlowQuitSpdOfSts1_s16s7_Bar /end REF_CHARACTERISTIC
 /begin REF_MEASUREMENT dPQuit /end REF_MEASUREMENT
/end GROUP
/begin GROUP S10_CoastCncl "RBM/Subsystem/RB_Enable_Mode/CoastCncl" /begin REF_CHARACTERISTIC K_RB_AbsActvCoastCnclEna_u8_Flg /end REF_CHARACTERISTIC /end GROUP
/begin GROUP S10_RBEna_Signals "RBM/Subsystem/RB_Enable_Mode/RBEna Signals"
 /begin SUB_GROUP S25_AntiLightBrakeAcceleration S25_Prefill_Function_Judger S25_Torque_Err_Debounce /end SUB_GROUP
/end GROUP
/begin GROUP S11_Subsystem1 "RBM/Subsystem/RB_Quit_Mode/Subsystem1" /begin SUB_GROUP S46_EHBAimP S46_PrefillPressure /end SUB_GROUP /end GROUP
/begin GROUP S11_Subsystem2 "RBM/Subsystem/RB_Quit_Mode/Subsystem2"
 /begin SUB_GROUP S47_AimTorque S47_CoastLmtCtrl S47_dpcaculator S47_dpcaculator_ABSActive /end SUB_GROUP
 /begin REF_MEASUREMENT V_RB_dpQuitMod_s16s7_Bar /end REF_MEASUREMENT
/end GROUP
/begin GROUP S12_Diag "RBM/Subsystem/RB_State_Judge/Diag" /begin REF_MEASUREMENT V_RBM_DiagInfo1_u16_Mode V_RBM_DiagInfo2_u16_Mode /end REF_MEASUREMENT /end GROUP
/begin GROUP S12_override "RBM/Subsystem/RB_State_Judge/override" /begin REF_CHARACTERISTIC K_RB_GearOverride_Ena K_RB_GearOverride_Flg /end REF_CHARACTERISTIC /end GROUP
/begin GROUP S25_AntiLightBrakeAcceleration "RBM/Subsystem/RB_Enable_Mode/RBEna Signals/AntiLightBrakeAcceleration" /begin SUB_GROUP S32_CoastBrakeCalculator /end SUB_GROUP
 /begin REF_CHARACTERISTIC K_RB_MapCoastTorqIncrementCoffe K_RB_MultiCoastTenseEna_u8_Flg /end REF_CHARACTERISTIC
/end GROUP
/begin GROUP S25_Prefill_Function_Judger "RBM/Subsystem/RB_Enable_Mode/RBEna Signals/Prefill Function Judger" /begin SUB_GROUP S33_PrefillPressure S33_tq2p /end SUB_GROUP
 /begin REF_CHARACTERISTIC K_RB_MapQuitMotorSpd_OutSpd_Rpm K_RB_PrefillCutInMotorSpdDelta_Rpm /end REF_CHARACTERISTIC
/end GROUP
/begin GROUP S25_Torque_Err_Debounce "RBM/Subsystem/RB_Enable_Mode/RBEna Signals/Torque Err Debounce"
 /begin REF_CHARACTERISTIC K_RB_TorqueErrorThreshold_0P1Nm K_RB_TorqueErrorTimeThreshold_5ms /end REF_CHARACTERISTIC
/end GROUP
/begin GROUP S46_EHBAimP "RBM/Subsystem/RB_Quit_Mode/Subsystem1/EHBAimP" /begin SUB_GROUP S48_quit_dp2dp /end SUB_GROUP /end GROUP
/begin GROUP S46_PrefillPressure "RBM/Subsystem/RB_Quit_Mode/Subsystem1/PrefillPressure" /begin REF_CHARACTERISTIC K_RB_MapPrefillForcePressure_OutP_s16En7Bar /end REF_CHARACTERISTIC /end GROUP
/begin GROUP S47_AimTorque "RBM/Subsystem/RB_Quit_Mode/Subsystem2/AimTorque" /begin SUB_GROUP S53_TqDelay S53_p2tq /end SUB_GROUP /end GROUP
/begin GROUP S47_CoastLmtCtrl "RBM/Subsystem/RB_Quit_Mode/Subsystem2/CoastLmtCtrl" /begin REF_CHARACTERISTIC K_RB_AbsActvCoastCnclEna_u8_Flg /end REF_CHARACTERISTIC /end GROUP
/begin GROUP S47_dpcaculator "RBM/Subsystem/RB_Quit_Mode/Subsystem2/dpcaculator" /begin SUB_GROUP S57_dp_norm_caculator S57_pressure_rising_stopping /end SUB_GROUP /end GROUP
/begin GROUP S47_dpcaculator_ABSActive "RBM/Subsystem/RB_Quit_Mode/Subsystem2/dpcaculator_ABSActive"
 /begin REF_CHARACTERISTIC K_RBM_AbsDlyP_s16s7_Bar K_RB_ABSDelay_Disable K_RB_ABSStepP_s16En7Bar /end REF_CHARACTERISTIC
/end GROUP
/begin GROUP S32_CoastBrakeCalculator "RBM/Subsystem/RB_Enable_Mode/RBEna Signals/AntiLightBrakeAcceleration/CoastBrakeCalculator"
 /begin REF_CHARACTERISTIC K_RB_MapCoastDown_OutTq_0P1Nm K_RB_MapVCUCoastTorq_0P1Nm K_RB_MultiCoastTenseEna_u8_Flg /end REF_CHARACTERISTIC
/end GROUP
/begin GROUP S33_PrefillPressure "RBM/Subsystem/RB_Enable_Mode/RBEna Signals/Prefill Function Judger/PrefillPressure" /begin REF_CHARACTERISTIC K_RB_MapPrefillForcePressure_OutP_s16En7Bar /end REF_CHARACTERISTIC /end GROUP
/begin GROUP S33_tq2p "RBM/Subsystem/RB_Enable_Mode/RBEna Signals/Prefill Function Judger/tq2p" /begin REF_CHARACTERISTIC K_RB_P2TqGain_null K_RB_P2TqOffset_null /end REF_CHARACTERISTIC /end GROUP
/begin GROUP S48_quit_dp2dp "RBM/Subsystem/RB_Quit_Mode/Subsystem1/EHBAimP/quit dp2dp"
 /begin REF_CHARACTERISTIC K_RB_MapQuitdP2dPGain_OutP_s16En7 K_RB_MapQuitdP2dPOffset_OutP_s16En7Bar K_RB_PBrkCoeff_s16s10_null /end REF_CHARACTERISTIC
/end GROUP
/begin GROUP S53_TqDelay "RBM/Subsystem/RB_Quit_Mode/Subsystem2/AimTorque/TqDelay" /begin REF_CHARACTERISTIC K_RB_MapQuitTqDelay_Out_5ms /end REF_CHARACTERISTIC /begin REF_MEASUREMENT V_RBM_DTqQuitMode_s16_0P1Nm /end REF_MEASUREMENT /end GROUP
/begin GROUP S53_p2tq "RBM/Subsystem/RB_Quit_Mode/Subsystem2/AimTorque/p2tq" /begin REF_CHARACTERISTIC K_RB_P2TqGain_null K_RB_P2TqOffset_null /end REF_CHARACTERISTIC /end GROUP
/begin GROUP S57_dp_norm_caculator "RBM/Subsystem/RB_Quit_Mode/Subsystem2/dpcaculator/dp_norm_caculator"
 /begin REF_CHARACTERISTIC K_RB_FullChargeQuit_Disable K_RB_MapStepPressure_OutP_s16En7Bar K_RB_MutiMapStepPressure_OutP_s16En7Bar /end REF_CHARACTERISTIC
/end GROUP
/begin GROUP S57_pressure_rising_stopping "RBM/Subsystem/RB_Quit_Mode/Subsystem2/dpcaculator/pressure_rising_stopping" /begin REF_CHARACTERISTIC K_RB_MtrSpdQuitStop_s16_Rpm K_RB_TqQuitStop_s16_0P1Nm /end REF_CHARACTERISTIC /end GROUP
/end MODULE
/end PROJECT
/* (add any file trailer comments here) */
/* EOF RBM.a2l */
